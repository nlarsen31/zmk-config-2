## boards/shields/corne_trackball_left/Kconfig
```kconfig
menuconfig PMW3610
	bool "PMW3610 Trackball Driver"
	select SPI
	help
	  Enable support for the PMW3610 optical trackball sensor

if PMW3610

config PMW3610_TRIGGER_GLOBAL_THREAD
	bool "Use global thread for PMW3610 trigger"
	default y

config PMW3610_ORIENTATION_0
	int "PMW3610 Sensor Orientation"
	default 0
	range 0 3
	help
	  0: Normal (0°)
	  1: 90° clockwise
	  2: 180°
	  3: 270° clockwise

config PMW3610_CPI
	int "PMW3610 CPI (Counts Per Inch)"
	default 1600
	range 200 3200

config PMW3610_RUN_DOWNSHIFT_TIME_MS
	int "PMW3610 Run downshift time (ms)"
	default 300

config PMW3610_REST1_DOWNSHIFT_TIME_MS
	int "PMW3610 Rest1 downshift time (ms)"
	default 1000

config PMW3610_REST2_DOWNSHIFT_TIME_MS
	int "PMW3610 Rest2 downshift time (ms)"
	default 10000

endif # PMW3610
```

## boards/shields/corne_trackball_left/Kconfig.defconfig
```kconfig
if SHIELD_CORNE_TRACKBALL_LEFT

config ZMK_KEYBOARD_NAME
	default "Corne Trackball"

endif
```

## boards/shields/corne_trackball_left/Kconfig.shield
```kconfig
config SHIELD_CORNE_TRACKBALL_LEFT
	def_bool $(shields_list_contains,corne_trackball_left)
```
